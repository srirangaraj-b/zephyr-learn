## CMakeLists.txt
```
cmake_minimum_required(VERSION 3.20.0)

find_package(Zephyr REQUIRED HINTS ENV{ZEPHYR_BASE})

project(adc1_check)

target_sources(app PRIVATE src/main.c)
```

## prj.conf
```kconfig
CONFIG_ADC=y
CONFIG_CONSOLE=y
CONFIG_SERIAL=y
CONFIG_PRINTK=y
CONFIG_BOOT_BANNER=n
CONFIG_UART_CONSOLE=y
```

## boards/nucleo_g070rb.overlay
```dts
/ {
    zephyr,user {
        io-channels = <&adc1 0>;
    };
};

&adc1 {
    status = "okay";
};
```

## src/main.c
```c
#include <zephyr/kernel.h>
#include <zephyr/drivers/adc.h>

#define ADC_NODE DT_PATH(zephyr_user)

static const struct adc_dt_spec adc_chan =
    ADC_DT_SPEC_GET(ADC_NODE);

int main(void)
{
    int16_t buf;
    struct adc_sequence sequence = {
        .buffer = &buf,
        .buffer_size = sizeof(buf),
    };

    adc_channel_setup_dt(&adc_chan);

    while (1) {
        adc_sequence_init_dt(&adc_chan, &sequence);

        if (adc_read(adc_chan.dev, &sequence) == 0) {
            printk("ADC = %d\n", buf);
        }

        k_sleep(K_MSEC(500));
    }
}
```
