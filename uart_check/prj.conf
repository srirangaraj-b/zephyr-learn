## CMakeLists.txt
```
cmake_minimum_required(VERSION 3.20.0)

find_package(Zephyr REQUIRED HINTS ENV{ZEPHYR_BASE})

project(uart_check)

target_sources(app PRIVATE src/main.c)
```

## prj.conf
```kconfig
CONFIG_SERIAL=y
CONFIG_UART_INTERRUPT_DRIVEN=y
CONFIG_CONSOLE=y
CONFIG_UART_CONSOLE=y
CONFIG_PRINTK=y
```

## boards/nucleo_g070rb.overlay
```dts
&usart1 {
    pinctrl-0 = <&usart1_tx_pc4 &usart1_rx_pc5>;
    pinctrl-names = "default";
    current-speed = <115200>;
    status = "okay";
};      
```

## boards/nucleo_n657x0_q.overlay
```dts
 * USART3 is already pin-mapped by the board (PD8=TX, PD9=RX)
 * but is disabled by default. USART1 stays reserved for the
 * Zephyr console, so we bring up USART3 for our own comms.
 */
&usart3 {
	status = "okay";
	current-speed = <115200>;
	pinctrl-0 = <&usart3_tx_pd8 &usart3_rx_pd9>;
	pinctrl-names = "default";
};
```

## src/main.c
```c
#include <zephyr/kernel.h>
#include <zephyr/device.h>
#include <zephyr/drivers/uart.h>
#include <string.h>

/*
 * On nucleo_n657x0_q, USART1 is the Zephyr console UART (PE5/PE6).
 * Don't attach a second ISR/consumer to it - use USART3 (PD8/PD9)
 * for your own link instead, enabled via the board overlay.
 */
#define COMMS_UART_NODE DT_NODELABEL(usart3)
static const struct device *comms_dev = DEVICE_DT_GET(COMMS_UART_NODE);

#define RX_BUF_SIZE 128
static char rx_buf[RX_BUF_SIZE];
static int rx_idx;

static void comms_uart_isr(const struct device *dev, void *user_data)
{
	ARG_UNUSED(user_data);

	uart_irq_update(dev);

	if (uart_irq_rx_ready(dev)) {
		uint8_t c;

		while (uart_fifo_read(dev, &c, 1) == 1) {
			if (c == '\n' || c == '\r') {
				if (rx_idx > 0) {
					rx_buf[rx_idx] = '\0';
					printk("Received: %s\n", rx_buf);
					rx_idx = 0;
				}
			} else if (rx_idx < RX_BUF_SIZE - 1) {
				rx_buf[rx_idx++] = c;
			} else {
				/* overflow guard: reset */
				rx_idx = 0;
			}
		}
	}
}

static void comms_send_line(const char *str)
{
	while (*str) {
		uart_poll_out(comms_dev, *str++);
	}
	uart_poll_out(comms_dev, '\n');
}

int main(void)
{
	if (!device_is_ready(comms_dev)) {
		printk("Comms UART (USART3) not ready\n");
		return -1;
	}

	uart_irq_callback_set(comms_dev, comms_uart_isr);
	uart_irq_rx_enable(comms_dev);

	while (1) {
		comms_send_line("Hello World from STM32N6");
		printk("Sent: Hello World from STM32N6\n");
		k_sleep(K_MSEC(1000));
	}

	return 0;
}
```
