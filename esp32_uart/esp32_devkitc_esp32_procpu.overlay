&pinctrl {
    uart2_default: uart2_default {
        group1 {
            pinmux = <UART2_TX_GPIO17>, <UART2_RX_GPIO16>;
        };
    };
};

&uart2 {
    status = "okay";
    current-speed = <115200>;
    pinctrl-0 = <&uart2_default>;
    pinctrl-names = "default";
};