## CMakeLists.txt
```
cmake_minimum_required(VERSION 3.20.0)

find_package(Zephyr REQUIRED HINTS ENV{ZEPHYR_BASE})

project(hello_world)

target_sources(app PRIVATE src/main.c)
```

## prj.conf
```kconfig
CONFIG_BOOT_BANNER=n

CONFIG_CONSOLE=y
CONFIG_UART_CONSOLE=y
CONFIG_PRINTK=y
```

## src/main.c
```c
#include <zephyr/kernel.h>

int main(){
    while(1){
    printk("Hello World!!\n");
    k_msleep(1000);
    }
}
```
