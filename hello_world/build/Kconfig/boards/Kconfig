## hello_world/build/Kconfig/boards/Kconfig
```kconfig
# Load Zephyr board Kconfig descriptions.
osource "C:/zephyrproject/zephyr/boards/st/nucleo_g070rb/Kconfig"
```

## hello_world/build/Kconfig/boards/Kconfig.defconfig
```kconfig
# Load Zephyr board defconfig descriptions.
osource "C:/zephyrproject/zephyr/boards/st/nucleo_g070rb/Kconfig.defconfig"
```

## hello_world/build/Kconfig/boards/Kconfig.nucleo_g070rb
```kconfig
# Load board Kconfig descriptions.
osource "C:/zephyrproject/zephyr/boards/st/nucleo_g070rb/Kconfig.nucleo_g070rb"
```

## hello_world/build/Kconfig/boards/Kconfig.sysbuild
```kconfig
# Load Sysbuild board Kconfig descriptions.
osource "C:/zephyrproject/zephyr/boards/st/nucleo_g070rb/Kconfig.sysbuild"
```
